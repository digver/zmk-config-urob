## config/west.yml
```yaml
manifest:
  remotes:
    - name: zmkfirmware
      url-base: https://github.com/zmkfirmware
    - name: urob
      url-base: https://github.com/urob
    - name: megamind
      url-base: https://github.com/megamind4089
    - name: digver
      url-base: https://github.com/digver
  projects:
    - name: zmk
      remote: urob
      revision: main
      import: app/west.yml
  self:
    path: config
```

## submodules/megmind4089-zmk-config/config/boards/arm/stemcell/stemcell_defconfig
```kconfig
# SPDX-License-Identifier: MIT
# Copyright (c) 2021 Mega Mind

CONFIG_BUILD_OUTPUT_UF2=y

CONFIG_SOC_SERIES_STM32F4X=y
CONFIG_SOC_STM32F401XC=y

# 168MHz system clock
CONFIG_SYS_CLOCK_HW_CYCLES_PER_SEC=84000000

# MPU Settings
CONFIG_ARM_MPU=y

# enable pinmux
CONFIG_PINMUX=y

# enable GPIO
CONFIG_GPIO=y

# Code partition
CONFIG_USE_DT_CODE_PARTITION=y

# Enable Clocks
CONFIG_CLOCK_CONTROL=y

# disable polling for both direct and matrix
CONFIG_ZMK_KSCAN_MATRIX_POLLING=y
CONFIG_ZMK_KSCAN_DIRECT_POLLING=y
```
